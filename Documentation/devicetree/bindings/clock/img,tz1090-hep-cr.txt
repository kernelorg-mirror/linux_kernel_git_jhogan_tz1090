## Documentation/devicetree/bindings/clock/img,tz1090-hep-cr.txt
```
Binding for TZ1090 High end peripheral clocks.

This binding uses the common clock binding[1]. It represents the clocks
controlled from the high end peripheral registers of the TZ1090:

[1] Documentation/devicetree/bindings/clock/clock-bindings.txt

Required properties:
- compatible         : Shall be "img,tz1090-hep-cr", "syscon".
- #clock-cells       : From common clock binding; shall be set to 1.
- reg                : Base address for clock registers in high end peripheral
                       register region.
- clocks             : Clock specifiers for each input clock.
- clock-names        : Labels for each input clock specified in clocks.
                       Can contain the following entries:
                       "sys"              : Main system clock.
                       "sys_x2_undeleted" : System clock before division and
                                            deletion.

Optional properties:
- clock-indices      : From common clock binding. Allows clock-output-names to
                       be sparse.
- clock-output-names : From common clock binding. May be used to name specific
                       output clocks so that other clock providers can find
                       the clocks by name before the provider has been
                       instantiated. Can contain:
                       "sys_2d", "ddr_en", "sys_pdp"

Clock Specifier Definition:
- <1st-cell>: Output clock number. Use constants from
              <dt-bindings/clock/tz1090-hep.h>.

Examples:
	hep_cr: hep_cr {
		compatible = "img,tz1090-hep-cr", "syscon";
		#clock-cells = <1>;
		reg = <0x02008c00 0x08>;
		/* input clocks */
		clocks = <&top_clks CLK_TOP_SYS>,
			 <&top_clks CLK_TOP_SYS_X2_UNDELETED>;
		clock-names = "sys",
			      "sys_x2_undeleted";
		/* output clocks for other clock providers */
		clock-indices = <CLK_HEP_DDR_EN>;
		clock-output-names = "ddr_en";
	};

	pdp {
		...
		clocks = <&hep_cr CLK_HEP_PDP>;
		clock-names = "pdp";
		...
	};
```

## Documentation/devicetree/bindings/clock/img,tz1090-pdc-cr.txt
```
Binding for TZ1090 PDC clocks.

This binding uses the common clock binding[1]. It represents the clocks
required to generate the 32KHz PDC clock used by the devices in the low power
domain:

          ___________
xtal1 ___| xtal1_div |____________________________
         |___________|  |    ________   xtal1_div
                        `--o| rtc_sw \____________
xtal3 ----------------------|________/  32khz

xtal1_div = xtal1 / (reg[26:16] + 1)
xtal3 = reg[30] ? xtal3 : xtal1_div


[1] Documentation/devicetree/bindings/clock/clock-bindings.txt

Required properties:
- compatible         : Shall be "img,tz1090-pdc-cr", "syscon".
- #clock-cells       : From common clock binding; shall be set to 1.
- reg                : Base address for registers controlling PDC clocks.
- clocks             : Clock specifiers for each input clock.
- clock-names        : Labels for each input clock specified in clocks.
                       Can contain the following entries:
                       "xtal1" : XTAL1 oscillator.
                       "xtal3" : XTAL3 32KHz oscillator.

Optional properties:
- clock-indices      : From common clock binding. Allows clock-output-names to
                       be sparse.
- clock-output-names : From common clock binding. May be used to name specific
                       output clocks so that other clock providers can find
                       the clocks by name before the provider has been
                       instantiated. Can contain:
                       "32khz"     : 32khz PDC clock.

Clock Specifier Definition:
- <1st-cell>: Output clock number. Use constants from
              <dt-bindings/clock/tz1090-pdc.h>.

Examples:
	pdc_cr: pdc_cr {
		compatible = "img,tz1090-pdc-cr", "syscon";
		#clock-cells = <1>;
		reg = <0x02006500 0x4>;	/* SOC_GPIO_CONTROL0 */
		clocks = <&xtal1>,
			 <&xtal3>;
		clock-names = "xtal1",
			      "xtal3";
	};

	ir {
		...
		clocks = <&pdc_cr CLK_PDC_32KHZ>,
			 <&top_cr CLK_TOP_PDC>;
		clock-names = "core", "sys";
		...
	};
```

## Documentation/devicetree/bindings/clock/img,tz1090-perip-cr.txt
```
Binding for TZ1090 Peripheral register clocks.

This binding uses the common clock binding[1]. It represents the clocks
controlled from the peripheral registers of the TZ1090:

[1] Documentation/devicetree/bindings/clock/clock-bindings.txt

Required properties:
- compatible         : Shall be "img,tz1090-perip-cr", "syscon".
- #clock-cells       : From common clock binding; shall be set to 1.
- reg                : Base address for clock registers in peripheral register
                       region.
- clocks             : Clock specifiers for each input clock.
- clock-names        : Labels for each input clock specified in clocks.
                       Can contain the following entries:
                       "sys" : Main system clock.

Optional properties:
- clock-indices      : From common clock binding. Allows clock-output-names to
                       be sparse.
- clock-output-names : From common clock binding. May be used to name specific
                       output clocks so that other clock providers can find
                       the clocks by name before the provider has been
                       instantiated. Can contain:
                       "sys_scb0", "sys_scb1", "sys_scb2", "sys_sdio",
                       "sys_uart0", "sys_uart1", "sys_spim", "sys_spis",
                       "sys_spim1", "sys_i2sout", "sys_i2sin", "sys_lcd",
                       "sys_sdhost", "sys_usb"

Clock Specifier Definition:
- <1st-cell>: Output clock number. Use constants from
              <dt-bindings/clock/tz1090-perip.h>.

Examples:
	perip_cr: perip_cr {
		compatible = "img,tz1090-perip-cr", "syscon";
		#clock-cells = <1>;
		reg = <0x02004000 0x18>;
		clocks = <&top_cr CLK_TOP_SYS>;
		clock-names = "sys";
	};

	i2c {
		...
		clocks = <&top_cr CLK_TOP_SCB>,
			 <&perip_cr CLK_PERIP_SCB0>;
		clock-names = "scb", "sys";
		...
	};
```

## Documentation/devicetree/bindings/clock/img,tz1090-top-cr.txt
```
Binding for TZ1090 Top level register clocks.

This binding uses the common clock binding[1]. It represents the clocks
controlled from the top level registers of the TZ1090, and encompasses most of
the complexity of the TZ1090 clock tree:

[1] Documentation/devicetree/bindings/clock/clock-bindings.txt

Required properties:
- compatible         : Shall be "img,tz1090-top-cr", "syscon".
- #clock-cells       : From common clock binding; shall be set to 1.
- reg                : Base address for clock registers in top level register
                       region.
- clocks             : Clock specifiers for each input clock.
- clock-names        : Labels for each input clock specified in clocks.
                       Can contain the following entries:
                       "xtal1"        : XTAL1 oscillator.
                       "xtal3"        : XTAL2 oscillator.
                       "ext_adc_dac"  : External ADC/DAC clock input.
                       "ddr_en"       : Output of HEP DDR clock gate.
                       "afe_progdiv1",
                       "afe_progdiv3",
                       "afe_rxsync",
                       "afe_txsync",
                       "iqadc_sync"   : Output clocks from AFE block.

Optional properties:
- clock-indices      : From common clock binding. Allows clock-output-names to
                       be sparse.
- clock-output-names : From common clock binding. May be used to name specific
                       output clocks so that other clock providers can find
                       the clocks by name before the provider has been
                       instantiated. Can contain:
                       "sys", "sys_x2_undeleted" "scb", "ext_stc0", "ext_stc1",
                       "if1", "if0", "sys_ucc1", "sys_mtx", "meta", "ucc0",
                       "ucc1_del", "sys_undeleted", "afe", "adcpll_div", "uart",
                       "pdm", "spi0", "spi1", "i2sm", "usb_phy", "sdhost",
                       "ring_osc", "i2s", "meta_trace", "pixel", "out0", "out1",
                       "ddr", "sys_pll", "sys_pdc"

Clock Specifier Definition:
- <1st-cell>: Output clock number. Use constants from
              <dt-bindings/clock/tz1090-top.h>.

Examples:
	top_cr: top_cr {
		compatible = "img,tz1090-top-cr", "syscon";
		#clock-cells = <1>;
		reg = <0x02005900 0xb0>;
		/* input clocks */
		clocks = <&xtal1>, <&xtal2>, <&ext_adc_dac>,
			 <&hep_cr CLK_HEP_DDR_EN>;
		clock-names = "xtal1", "xtal2", "ext_adc_dac",
			      "ddr_en";
		/* output clocks for other clock providers */
		clock-indices = <CLK_TOP_SYS>,
				<CLK_TOP_SYS_X2_UNDELETED>;
		clock-output-names = "sys",
				     "sys_x2_undeleted";
	};

	ir {
		...
		clocks = <&pdc_cr CLK_PDC_32KHZ>,
			 <&top_cr CLK_TOP_PDC>;
		clock-names = "core", "sys";
		...
	};
```

## Documentation/devicetree/bindings/clock/specified-clock.txt
```
Binding for discoverable-fixed-rate clock sources.

This binding uses the common clock binding[1].

[1] Documentation/devicetree/bindings/clock/clock-bindings.txt

Required properties:
- compatible : shall be "specified-clock".
- #clock-cells : from common clock binding; shall be set to 0.
- bit-mask : Mask of bits in the field specifying the frequency.
- table : array of integer pairs defining register field values and
          corresponding clock frequencies in Hz.

Optional properties:
- reg : Base address of configuration register specifying the frequency.
- syscon-reg : Phandle to syscon node and offset of syscon register.
- bit-shift : Number of bits to shift the masked register value.
              Defaults to (ffs(bit-mask) - 1) if absent.
- clock-accuracy : accuracy of clock in ppb (parts per billion).
                   Should be a single cell.
- clock-output-names : From common clock binding.

NOTE: One of reg or syscon-reg must be provided.

Examples:
	clock {
		compatible = "specified-clock";
		#clock-cells = <0>;
		reg = <0x02004004 0x4>;		/* CR_PERIP_RESET_CFG */
		bit-mask = <0x00000f00>;	/* FXTAL */
		table =	/*	FXTAL	Frequency */
				<0	16384000>,
				<1	19200000>,
				<2	24000000>,
				<3	24576000>,
				<4	26000000>,
				<5	36000000>,
				<6	36864000>,
				<7	38400000>,
				<8	40000000>;
		clock-accuracy = <100>;
		clock-output-names = "xtal1";
	};

	clock {
		compatible = "specified-clock";
		#clock-cells = <0>;
		syscon-reg = <&perip_cr 0x4>;	/* CR_PERIP_RESET_CFG */
		bit-mask = <0x00000f00>;	/* FXTAL */
		table =	/*	FXTAL	Frequency */
				<0	16384000>,
				<1	19200000>,
				<2	24000000>,
				<3	24576000>,
				<4	26000000>,
				<5	36000000>,
				<6	36864000>,
				<7	38400000>,
				<8	40000000>;
		clock-accuracy = <100>;
		clock-output-names = "xtal1";
	};
```

## arch/metag/configs/tz1090_defconfig
```kconfig
# CONFIG_LOCALVERSION_AUTO is not set
# CONFIG_SWAP is not set
CONFIG_SYSVIPC=y
CONFIG_SYSFS_DEPRECATED=y
CONFIG_SYSFS_DEPRECATED_V2=y
CONFIG_KALLSYMS_ALL=y
# CONFIG_ELF_CORE is not set
CONFIG_SLAB=y
# CONFIG_BLK_DEV_BSG is not set
CONFIG_PARTITION_ADVANCED=y
# CONFIG_MSDOS_PARTITION is not set
# CONFIG_IOSCHED_DEADLINE is not set
# CONFIG_IOSCHED_CFQ is not set
CONFIG_FLATMEM_MANUAL=y
CONFIG_SOC_TZ1090=y
CONFIG_METAG_HALT_ON_PANIC=y
# CONFIG_METAG_FPU is not set
CONFIG_METAG_DA=y
CONFIG_HZ_100=y
CONFIG_DEVTMPFS=y
# CONFIG_STANDALONE is not set
# CONFIG_PREVENT_FIRMWARE_BUILD is not set
# CONFIG_FW_LOADER is not set
CONFIG_BLK_DEV_RAM=y
CONFIG_BLK_DEV_RAM_COUNT=1
CONFIG_BLK_DEV_RAM_SIZE=16384
# CONFIG_VT is not set
# CONFIG_LEGACY_PTYS is not set
CONFIG_DA_TTY=y
CONFIG_DA_CONSOLE=y
# CONFIG_DEVKMEM is not set
CONFIG_SERIAL_8250=y
# CONFIG_SERIAL_8250_DEPRECATED_OPTIONS is not set
CONFIG_SERIAL_8250_CONSOLE=y
CONFIG_SERIAL_8250_NR_UARTS=2
CONFIG_SERIAL_8250_RUNTIME_UARTS=2
CONFIG_SERIAL_8250_DW=y
# CONFIG_HW_RANDOM is not set
CONFIG_I2C=y
CONFIG_I2C_IMG=y
CONFIG_GPIOLIB=y
# CONFIG_HWMON is not set
CONFIG_WATCHDOG=y
CONFIG_WATCHDOG_CORE=y
CONFIG_IMGPDC_WDT=y
CONFIG_MFD_SYSCON=y
CONFIG_MEDIA_SUPPORT=y
CONFIG_MEDIA_RC_SUPPORT=y
# CONFIG_RC_DECODERS is not set
CONFIG_RC_DEVICES=y
CONFIG_IR_IMG=y
CONFIG_IR_IMG_NEC=y
CONFIG_IR_IMG_JVC=y
CONFIG_IR_IMG_SONY=y
CONFIG_IR_IMG_SHARP=y
CONFIG_IR_IMG_SANYO=y
# CONFIG_USB_SUPPORT is not set
CONFIG_NEW_LEDS=y
CONFIG_LEDS_CLASS=y
CONFIG_LEDS_GPIO=y
CONFIG_LEDS_TRIGGERS=y
# CONFIG_DNOTIFY is not set
CONFIG_TMPFS=y
# CONFIG_MISC_FILESYSTEMS is not set
# CONFIG_SCHED_DEBUG is not set
CONFIG_DEBUG_INFO=y
```
